## arch/arc/configs/haps_hs_accel_debug_defconfig
```kconfig
CONFIG_SYSVIPC=y
# CONFIG_CROSS_MEMORY_ATTACH is not set
CONFIG_NO_HZ_IDLE=y
CONFIG_HIGH_RES_TIMERS=y
CONFIG_PREEMPT=y
CONFIG_NAMESPACES=y
# CONFIG_UTS_NS is not set
# CONFIG_PID_NS is not set
CONFIG_BLK_DEV_INITRD=y
CONFIG_INITRAMFS_SOURCE="${BR_BINARIES_DIR}/rootfs.cpio"
# CONFIG_RD_BZIP2 is not set
# CONFIG_RD_LZMA is not set
# CONFIG_RD_XZ is not set
# CONFIG_RD_LZO is not set
# CONFIG_RD_LZ4 is not set
# CONFIG_RD_ZSTD is not set
CONFIG_CC_OPTIMIZE_FOR_SIZE=y
CONFIG_EXPERT=y
# CONFIG_VM_EVENT_COUNTERS is not set
# CONFIG_COMPAT_BRK is not set
CONFIG_SLAB=y
CONFIG_MODULES=y
CONFIG_LINUX_LINK_BASE=0xB0000000
CONFIG_ARC_BUILTIN_DTB_NAME="haps_hs_accel_debug"
# CONFIG_BLOCK is not set
# CONFIG_COREDUMP is not set
# CONFIG_COMPACTION is not set
CONFIG_DEVTMPFS=y
CONFIG_DEVTMPFS_MOUNT=y
# CONFIG_STANDALONE is not set
# CONFIG_INPUT_KEYBOARD is not set
# CONFIG_INPUT_MOUSE is not set
# CONFIG_SERIO is not set
# CONFIG_LEGACY_PTYS is not set
CONFIG_SERIAL_8250=y
CONFIG_SERIAL_8250_CONSOLE=y
CONFIG_SERIAL_8250_NR_UARTS=1
CONFIG_SERIAL_8250_RUNTIME_UARTS=1
CONFIG_SERIAL_8250_DW=y
CONFIG_SERIAL_OF_PLATFORM=y
# CONFIG_HW_RANDOM is not set
# CONFIG_HWMON is not set
# CONFIG_USB_SUPPORT is not set
# CONFIG_VIRTIO_MENU is not set
# CONFIG_VHOST_MENU is not set
# CONFIG_IOMMU_SUPPORT is not set
CONFIG_REMOTEPROC=y
# CONFIG_DNOTIFY is not set
# CONFIG_INOTIFY_USER is not set
CONFIG_TMPFS=y
# CONFIG_MISC_FILESYSTEMS is not set
# CONFIG_DEBUG_MISC is not set
# CONFIG_FTRACE is not set
CONFIG_PM=y
CONFIG_PM_DEBUG=y
CONFIG_PM_ADVANCED_DEBUG=y
CONFIG_PM_CLK=y
CONFIG_PM_GENERIC_DOMAINS=y
CONFIG_PM_GENERIC_DOMAINS_OF=y
CONFIG_DRM_ACCEL_SNPS=y
CONFIG_DRM_ACCEL_SNPS_DEBUG=y
CONFIG_DEBUG_INFO=y
CONFIG_DEBUG_INFO_DWARF4=y
CONFIG_PANIC_ON_OOPS=y
CONFIG_PANIC_ON_OOPS_VALUE=1
```

## drivers/accel/snps/Kconfig
```kconfig
# SPDX-License-Identifier: GPL-2.0-only

config DRM_ACCEL_SNPS
	tristate "Synopsys AI accelerator"
	depends on PM && OF && REMOTEPROC && !REMOTEPROC_CDEV
	select DMA_SHARED_BUFFER
	select PM_GENERIC_DOMAINS
	help
	  Choose this option if users have one or more AI accelerator system(s)
	  with Synopsys AI accelerator(s) and management component(s). For example,
	  Synopsys ARC NPX NPU (Neural Processing Unit) processor, ARC VPX DSP
	  (Digitial Signal Processing) processor, and/or management component(s)
	  which can be used for synchronization and control of multiple processors
	  assembled in the AI accelerator system(s). Please note the driver doesn't
	  work with DRM for now.

	  If "M" is selected, the module will be called snps_accel.

config DRM_ACCEL_SNPS_DEBUG
	bool "Synopsys AI accelerator debug mode"
	depends on DRM_ACCEL_SNPS
	help
	  Choose this option to enable additional debug features.
```

## drivers/remoteproc/snps_accel/Kconfig
```kconfig
# SPDX-License-Identifier: GPL-2.0-only

config SNPS_ACCEL_RPROC
	tristate "Synopsys VPX/NPX remoteproc support"
	depends on REMOTEPROC
	select SNPS_ARCSYNC
	help
	  Say y here to support Synopsys VPX/NPX processors via the
	  remote processor framework.

	  This can be either built-in or a loadable module.

config SNPS_ACCEL_RPROC_CBU_IOMMU_BYPASS
    bool "Enable IOMMU bypass for CBU access in rproc driver"
    depends on SNPS_ACCEL_RPROC
    depends on IOMMU_API
    default n
    help
      Enable a special IOMMU configuration that bypasses IOMMU
      translation for scalar accesses from ARC CPUs of NPX/VPX
      devices to system RAM through the CBU bus.

      This option is intended for the Xilinx Zynq development
      platform. Unless your platform requires this workaround,
      say N.
```
